## CMakeLists.txt
```
cmake_minimum_required(VERSION 3.20)

# check BOARD variable
if(NOT BOARD)
    set(BOARD damiao_mc02)
    message("BOARD not defined, use default value: ${BOARD}")
else()
    message("Use BOARD: ${BOARD}")
endif()

# import zephyr library
find_package(Zephyr REQUIRED HINTS $ENV{ZEPHYR_BASE})
# define cmake project
project(wheelLeg)

target_sources(app PRIVATE
    ./src/main.cpp
)
```

## prj.conf
```kconfig
# 启用日志
CONFIG_LOG=y
CONFIG_LOG_MODE_IMMEDIATE=y
#启用矩阵库
CONFIG_FPU=y
CONFIG_CMSIS_DSP=y
CONFIG_CMSIS_DSP_MATRIX=y
# 启用浮点支持
CONFIG_FPU_SHARING=y
CONFIG_DEBUG_OPTIMIZATIONS=n
CONFIG_USE_SEGGER_RTT=y
CONFIG_RTT_CONSOLE=y
CONFIG_UART_CONSOLE=n

# Optional: Enable RTT logging backend
CONFIG_LOG_BACKEND_RTT=y
CONFIG_LOG_BACKEND_UART=n

# 栈大小（FPU 需要更大的栈）
CONFIG_MAIN_STACK_SIZE=4096
```

## src/main.cpp
```c
#include "zephyr/device.h"
#include "zephyr/drivers/sensor.h"
#include "zephyr/kernel.h"
#include <zephyr/logging/log.h>
LOG_MODULE_REGISTER(Straight_leg, LOG_LEVEL_INF);

#include "../AlgorithmLayer/Include/StraightLeg.h"

using namespace straightLeg;

int main()
{
	StraightLeg straight_leg;
	while (1)
	{
		straight_leg.state_info.update_state(0.1f, 0.01f, 0.2f, 0.02f, 0.05f, 0.005f);
		float state[6];
		straight_leg.state_info.get_state(state);
		LOG_INF("State: thetal=%.3f, thetald1=%.3f, s=%.3f, sd1=%.3f, thetab=%.3f, thetabd1=%.3f", state[0], state[1], state[2], state[3], state[4], state[5]);
		k_msleep(500);
	}
}
```
