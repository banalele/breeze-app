## CMakeLists.txt
```
cmake_minimum_required(VERSION 3.20)

# check BOARD variable
if(NOT BOARD)
    set(BOARD damiao_mc02)
    message("BOARD not defined, use default value: ${BOARD}")
else()
    message("Use BOARD: ${BOARD}")
endif()

# import zephyr library
find_package(Zephyr REQUIRED HINTS $ENV{ZEPHYR_BASE})

# define cmake project
project(imu_atom)

# 直接添加所有源文件到 app
target_sources(app PRIVATE
    src/main.c
    src/imu_xrobot.c
    src/imu_uart.c
)
```

## prj.conf
```kconfig
# 启用日志
CONFIG_LOG=y
CONFIG_LOG_MODE_IMMEDIATE=y
#CONFIG_LOG_MODE_DEFERRED=y
#CONFIG_LOG_PROCESS_THREAD_STACK_SIZE=4096

# # C++ 支持（重要！）
CONFIG_CPP=y
CONFIG_STD_CPP17=y


#  Enable RTT logging backend
CONFIG_CONSOLE=y
CONFIG_LOG_BACKEND_RTT=y
CONFIG_LOG_BACKEND_UART=n
CONFIG_USE_SEGGER_RTT=y
CONFIG_RTT_CONSOLE=y
CONFIG_UART_CONSOLE=n
CONFIG_SEGGER_RTT_MAX_NUM_UP_BUFFERS=5
CONFIG_SEGGER_RTT_MAX_NUM_DOWN_BUFFERS=2

# ---- 板载可控电源 PC15（配置见 boards/damiao_mc02.overlay 的 gpio-hog）----
CONFIG_GPIO=y

# ---- ATOM-IMU 串口接收（USART10，2000000 8N1，DMA 异步）----
CONFIG_SERIAL=y
CONFIG_UART_ASYNC_API=y
CONFIG_NOCACHE_MEMORY=y
CONFIG_RING_BUFFER=y

# 主线程栈（VOFA 输出 + 帧解析）
CONFIG_MAIN_STACK_SIZE=4096
```

## boards/damiao_mc02.overlay
```dts
/* This file will automatic applyed when using damiao_mc02 board */

&gpioc {
	/* 板载可控电源使能：PC15 高电平开电
	 * gpio-hog：Zephyr 在 POST_KERNEL 自动把该引脚配成输出并拉高，
	 * 早于 main()，不需要任何电源管理代码。
	 */
	imu_vcc: imu-vcc {
		gpio-hog;
		gpios = <15 GPIO_ACTIVE_HIGH>;
		output-high;
		line-name = "imu_vcc";
	};
};

&usart10 {
	current-speed = <2000000>;
};
```

## src/main.c
```c
#include "zephyr/kernel.h"
#include <zephyr/logging/log.h>
#include <SEGGER_RTT.h>

#include "imu_uart.h"
#include "imu_xrobot.h"

// RTT 通道索引
#define RTT_CH_LOG 0	// 通道 0 RTT 日志输出通道
#define RTT_CH_VOFA_1 1 // 通道 1
#define RTT_CH_VOFA_2 2 // 通道 2

static uint8_t vofa_buf_1[4096]; // 用于通道 1
static uint8_t vofa_buf_2[4096]; // 用于通道 2
// VOFA+ JustFloat模式 帧尾
static const uint8_t vofa_tail[4] = {0x00, 0x00, 0x80, 0x7F};

/* RTT 上报周期：10 ms = 100 Hz
 * 串口解析仍是 1 ms（必须快，否则 ring 会溢出），只是发送降频
 */
#define VOFA_PERIOD_MS 10

LOG_MODULE_REGISTER(imu_atom, LOG_LEVEL_INF); // 开启日志模块



// 配置 RTT 通道
void vofa_rtt_init(void)
{
	// 上行通道
	SEGGER_RTT_ConfigUpBuffer(
		RTT_CH_VOFA_1,				  // 通道索引
		"vofa_channel_1",			  // 通道名称（仅供调试器显示）
		vofa_buf_1,					  // 缓冲区地址
		sizeof(vofa_buf_1),			  // 缓冲区大小
		SEGGER_RTT_MODE_NO_BLOCK_SKIP // 无阻塞模式：空间不足时丢弃新数据，不等待
	);
	SEGGER_RTT_ConfigUpBuffer(
		RTT_CH_VOFA_2,
		"vofa_channel_2",
		vofa_buf_2,
		sizeof(vofa_buf_2),
		SEGGER_RTT_MODE_NO_BLOCK_SKIP);

	LOG_INF("VOFA RTT channel configured\r\n");
}

int main(void)
{
	vofa_rtt_init(); // 初始化 VOFA RTT 通道

	if (imu_uart_start() < 0)
	{
		LOG_ERR("ATOM-IMU 串口初始化失败");
	}

	int64_t stat_tick = k_uptime_get();
	int64_t vofa_tick = 0;

	while (1)
	{
		/* 串口数据 -> 环形缓冲 -> 组帧解析 -> imu_data（每 1 ms 一次） */
		imu_update();

		/* RTT 发送降频到 VOFA_PERIOD_MS，避免日志链路拖慢主循环 */
		int64_t now = k_uptime_get();
		if ((now - vofa_tick) >= VOFA_PERIOD_MS)
		{
			vofa_tick = now;

			float vofa_data[] = {
				(float)k_uptime_get_32() / 1000.0f, // 时间戳（秒）
				(float)(imu_data.time[0] | (imu_data.time[1] << 8) | (imu_data.time[2] << 16) | (imu_data.time[3] << 24)), // 微秒时间戳（低 32 位）
				(float)imu_data.eulr_.yaw,					// 偏航角（度）
				(float)imu_data.eulr_.pit,					// 俯仰角（度）
				(float)imu_data.eulr_.rol,					// 横滚角（度）
			};
			// 将数据包写入 RTT 上行通道
			SEGGER_RTT_Write(RTT_CH_VOFA_1, vofa_data, sizeof(vofa_data));
			// 写入帧尾
			SEGGER_RTT_Write(RTT_CH_VOFA_1, vofa_tail, sizeof(vofa_tail));
		}

		/* 每 5 s 打印一次当前姿态 */
		if ((k_uptime_get() - stat_tick) >= 5000)
		{
			stat_tick = k_uptime_get();
			LOG_INF("yaw=%+6f, pitch=%+6f, roll=%+6f",
					(double)imu_data.eulr_.yaw, (double)imu_data.eulr_.pit, (double)imu_data.eulr_.rol);
		}

		k_sleep(K_MSEC(1));
	}
}
```

## src/imu_uart.c
```c
/**
 ******************************************************************************
 * @file        imu_uart.c
 * @brief       ATOM-IMU 串口传输层（Zephyr）：USART10 DMA 接收
 *
 * 对应 HAL 版 drv_uart.c 中 USART1 + DMA 循环 + 空闲中断：
 *   DMA 直接把字节搬进 nocache 缓冲，收满一块或总线空闲时回调，
 *   回调里只把数据拷进环形缓冲；主循环每 1 ms 调用 imu_update() 解析。
 *
 * 调用关系：USART10 DMA -> 环形缓冲 -> imu_update() -> imu_encode()
 *
 * 设备树：damiao_mc02 的 usart10（RX=PE2, TX=PE3, 2000000 8N1, 已开 FIFO）
 ******************************************************************************
 */

#include <errno.h>
#include <string.h>

#include <zephyr/device.h>
#include <zephyr/devicetree.h>
#include <zephyr/drivers/uart.h>
#include <zephyr/kernel.h>
#include <zephyr/linker/section_tags.h>
#include <zephyr/logging/log.h>
#include <zephyr/sys/ring_buffer.h>

#include "imu_uart.h"
#include "imu_xrobot.h"

LOG_MODULE_REGISTER(imu_uart, LOG_LEVEL_INF);

#define IMU_UART_NODE DT_NODELABEL(usart10)

/* 环形缓冲：2000000 baud 下约 20 ms 的数据量（DMA 回调写、线程读） */
#define IMU_RX_RING_SIZE 4096
/* 解析暂存区，对应 HAL 版的 USART1_RX_BUF_LEN */
#define IMU_RX_STAGE_SIZE 128
/* DMA 乒乓缓冲大小：256 B 约 1.28 ms 数据 */
#define IMU_DMA_BUF_SIZE 256

static const struct device *const imu_dev = DEVICE_DT_GET(IMU_UART_NODE);

RING_BUF_DECLARE(imu_ring_buffer, IMU_RX_RING_SIZE);

/* DMA 目标缓冲必须在 nocache 段，否则 D-Cache 会读到旧数据 */
static uint8_t dma_buf_a[IMU_DMA_BUF_SIZE] __nocache __aligned(32);
static uint8_t dma_buf_b[IMU_DMA_BUF_SIZE] __nocache __aligned(32);
/* 空闲的备用缓冲，驱动请求时交出去；NULL 表示暂无 */
static uint8_t *dma_spare = dma_buf_b;

/* 未解析完的尾部数据暂存（跨 imu_update() 调用保留） */
static uint8_t stage_buf[IMU_RX_STAGE_SIZE];
static size_t stage_len;

/**
 * @brief USART10 接收回调（DMA 异步事件，运行在中断上下文）
 *
 * RX_RDY          ：DMA 已收到数据，拷进环形缓冲
 * RX_BUF_REQUEST  ：驱动要下一块缓冲，交出 dma_spare
 * RX_BUF_RELEASED ：驱动用完一块，回收成 dma_spare
 * RX_DISABLED     ：出错/被停，重新开启接收
 */
static void USART10_rxDataHandler(const struct device *dev,
				  struct uart_event *evt, void *user_data)
{
	ARG_UNUSED(user_data);

	switch (evt->type)
	{
	case UART_RX_RDY:
		(void)ring_buf_put(&imu_ring_buffer,
				   &evt->data.rx.buf[evt->data.rx.offset],
				   (uint32_t)evt->data.rx.len);
		break;

	case UART_RX_BUF_REQUEST:
		if (dma_spare != NULL)
		{
			uint8_t *buf = dma_spare;

			dma_spare = NULL;
			(void)uart_rx_buf_rsp(dev, buf, IMU_DMA_BUF_SIZE);
		}
		break;

	case UART_RX_BUF_RELEASED:
		dma_spare = evt->data.rx_buf.buf;
		break;

	case UART_RX_DISABLED:
		/* 重新开始：a 交给驱动，b 留作备用 */
		dma_spare = dma_buf_b;
		(void)uart_rx_enable(dev, dma_buf_a, IMU_DMA_BUF_SIZE, 0);
		break;

	default:
		break;
	}
}

int imu_uart_start(void)
{
	int ret;

	if (!device_is_ready(imu_dev))
	{
		LOG_ERR("USART10 未就绪，请检查设备树 DT_NODELABEL(usart10)");
		return -ENODEV;
	}

	imu_xrobot_init(); /* 清空 imu_data */

	stage_len = 0; /* 丢掉可能残留的半帧 */

	ret = uart_callback_set(imu_dev, USART10_rxDataHandler, NULL);
	if (ret < 0)
	{
		LOG_ERR("注册 UART 异步回调失败 (%d)，需要 CONFIG_UART_ASYNC_API=y", ret);
		return ret;
	}

	/* 乒乓缓冲：a 交给驱动，b 留作备用 */
	dma_spare = dma_buf_b;

	/* timeout = 0：用总线空闲(IDLE)检测分包；DMA 收满一整块也会回调 */
	ret = uart_rx_enable(imu_dev, dma_buf_a, IMU_DMA_BUF_SIZE, 0);
	if (ret < 0)
	{
		LOG_ERR("启动 USART10 DMA 接收失败 (%d)，检查 dmas / DMAMUX / nocache 配置", ret);
		return ret;
	}

	LOG_INF("ATOM-IMU DMA 接收已启动：%s", imu_dev->name);

	return 0;
}

void imu_update(void)
{
	uint16_t used;

	/* 一次调用可能积压多帧（ring 比暂存区大），循环取到只剩半帧为止 */
	for (;;)
	{
		/* 1. 环形缓冲 -> 暂存区尾部（stage_len 同时充当写指针） */
		stage_len += ring_buf_get(&imu_ring_buffer, &stage_buf[stage_len],
								  sizeof(stage_buf) - stage_len);

		/* 2. 解析，返回真正吃掉多少字节 */
		used = imu_encode(stage_buf, (uint16_t)stage_len);

		if (used == 0)
		{
			break; /* 凑不满一帧，等下一批数据 */
		}

		/* 3. 丢弃已解析部分，把残余的半帧挪到 buf 开头 */
		stage_len -= used;
		memmove(stage_buf, &stage_buf[used], stage_len);
	}
}
```

## src/imu_uart.h
```c
/**
 ******************************************************************************
 * @file        imu_uart.h
 * @brief       ATOM-IMU 串口传输层（Zephyr）：USART10 DMA 接收
 ******************************************************************************
 */

#ifndef IMU_UART_H
#define IMU_UART_H

#include <stdint.h>

/**
 * @brief 启动 USART10 DMA 接收
 *
 * 依次完成：检查设备就绪 -> 清空 imu_data -> 清掉残余半帧 ->
 * 注册异步事件回调 -> 启动 DMA 接收。之后需在主循环中调用 imu_update()。
 *
 * USART10: RX = PE2, TX = PE3（引脚/波特率/时钟/DMA 通道均在设备树中配置）
 *
 * @return 0 成功，-ENODEV 设备未就绪，其他负值为注册回调/启动 DMA 失败的错误码
 */
int imu_uart_start(void);

/**
 * @brief 从环形缓冲取数据并组帧解析，结果写入 imu_data
 *
 * 内部调用 imu_encode()；一次调用会一直解析到剩余不足一帧为止，
 * 残帧留在暂存区等下次继续拼。
 *
 * 需要在主循环中周期调用，建议每 1 ms 一次（2 Mbaud 下约 3 帧/ms）。
 */
void imu_update(void);

#endif /* IMU_UART_H */
```

## src/imu_xrobot.c
```c
/**
 ******************************************************************************
 * @file        imu_xrobot.c
 * @brief       ATOM-IMU 成品陀螺仪 UART 通信协议层（Zephyr 移植版）
 *
 * 本文件只做协议相关的事情（CRC + 帧解析），不碰任何串口寄存器。
 * 串口收发在 imu_uart.c 中完成：
 *   USART10 DMA -> 环形缓冲 -> imu_update() -> imu_encode()
 ******************************************************************************
 */

#include <string.h>

#include "imu_xrobot.h"

/* Exported variables --------------------------------------------------------*/
ImuUartData imu_data;

/* Private constants ---------------------------------------------------------*/

/** @brief CRC8 查表（多项式 0x31） */
static const uint8_t CRC8_TAB[256] = {
	0x00, 0x5e, 0xbc, 0xe2, 0x61, 0x3f, 0xdd, 0x83,
	0xc2, 0x9c, 0x7e, 0x20, 0xa3, 0xfd, 0x1f, 0x41,
	0x9d, 0xc3, 0x21, 0x7f, 0xfc, 0xa2, 0x40, 0x1e,
	0x5f, 0x01, 0xe3, 0xbd, 0x3e, 0x60, 0x82, 0xdc,
	0x23, 0x7d, 0x9f, 0xc1, 0x42, 0x1c, 0xfe, 0xa0,
	0xe1, 0xbf, 0x5d, 0x03, 0x80, 0xde, 0x3c, 0x62,
	0xbe, 0xe0, 0x02, 0x5c, 0xdf, 0x81, 0x63, 0x3d,
	0x7c, 0x22, 0xc0, 0x9e, 0x1d, 0x43, 0xa1, 0xff,
	0x46, 0x18, 0xfa, 0xa4, 0x27, 0x79, 0x9b, 0xc5,
	0x84, 0xda, 0x38, 0x66, 0xe5, 0xbb, 0x59, 0x07,
	0xdb, 0x85, 0x67, 0x39, 0xba, 0xe4, 0x06, 0x58,
	0x19, 0x47, 0xa5, 0xfb, 0x78, 0x26, 0xc4, 0x9a,
	0x65, 0x3b, 0xd9, 0x87, 0x04, 0x5a, 0xb8, 0xe6,
	0xa7, 0xf9, 0x1b, 0x45, 0xc6, 0x98, 0x7a, 0x24,
	0xf8, 0xa6, 0x44, 0x1a, 0x99, 0xc7, 0x25, 0x7b,
	0x3a, 0x64, 0x86, 0xd8, 0x5b, 0x05, 0xe7, 0xb9,
	0x8c, 0xd2, 0x30, 0x6e, 0xed, 0xb3, 0x51, 0x0f,
	0x4e, 0x10, 0xf2, 0xac, 0x2f, 0x71, 0x93, 0xcd,
	0x11, 0x4f, 0xad, 0xf3, 0x70, 0x2e, 0xcc, 0x92,
	0xd3, 0x8d, 0x6f, 0x31, 0xb2, 0xec, 0x0e, 0x50,
	0xaf, 0xf1, 0x13, 0x4d, 0xce, 0x90, 0x72, 0x2c,
	0x6d, 0x33, 0xd1, 0x8f, 0x0c, 0x52, 0xb0, 0xee,
	0x32, 0x6c, 0x8e, 0xd0, 0x53, 0x0d, 0xef, 0xb1,
	0xf0, 0xae, 0x4c, 0x12, 0x91, 0xcf, 0x2d, 0x73,
	0xca, 0x94, 0x76, 0x28, 0xab, 0xf5, 0x17, 0x49,
	0x08, 0x56, 0xb4, 0xea, 0x69, 0x37, 0xd5, 0x8b,
	0x57, 0x09, 0xeb, 0xb5, 0x36, 0x68, 0x8a, 0xd4,
	0x95, 0xcb, 0x29, 0x77, 0xf4, 0xaa, 0x48, 0x16,
	0xe9, 0xb7, 0x55, 0x0b, 0x88, 0xd6, 0x34, 0x6a,
	0x2b, 0x75, 0x97, 0xc9, 0x4a, 0x14, 0xf6, 0xa8,
	0x74, 0x2a, 0xc8, 0x96, 0x15, 0x4b, 0xa9, 0xf7,
	0xb6, 0xe8, 0x0a, 0x54, 0xd7, 0x89, 0x6b, 0x35};

/* Exported functions --------------------------------------------------------*/

uint8_t imu_crc8_calc(const uint8_t *data, uint16_t len)
{
	uint8_t crc = IMU_CRC_INIT;

	for (uint16_t i = 0; i < len; i++)
	{
		crc = CRC8_TAB[crc ^ data[i]];
	}

	return crc;
}

void imu_xrobot_init(void)
{
	memset(&imu_data, 0, sizeof(ImuUartData));
}

uint16_t imu_encode(const uint8_t *rx_buf, uint16_t rx_len)
{
	uint16_t i = 0;

	while (i < rx_len)
	{
		/* 查找帧头 0xA5 */
		while (i < rx_len && rx_buf[i] != IMU_FRAME_HEAD)
		{
			i++;
		}

		if (i >= rx_len)
		{
			break;
		}

		/* 尾部不足一帧，留给下一次 */
		if ((uint32_t)i + IMU_FRAME_SIZE > rx_len)
		{
			break;
		}

		const uint8_t *frame = &rx_buf[i];

		if (imu_crc8_calc(frame, IMU_FRAME_SIZE - 1) == frame[IMU_FRAME_SIZE - 1])
		{
			memcpy(&imu_data, frame, sizeof(ImuUartData));

			/* 欧拉角弧度转度 */
			imu_data.eulr_.yaw *= RAD_TO_DEG;
			imu_data.eulr_.pit *= RAD_TO_DEG;
			imu_data.eulr_.rol *= RAD_TO_DEG;
		}

		i += IMU_FRAME_SIZE;
	}

	return i;
}
```

## src/imu_xrobot.h
```c
/**
 ******************************************************************************
 * @file        imu_xrobot.h
 * @brief       ATOM-IMU 成品陀螺仪 UART 通信协议层（Zephyr 移植版）
 *
 * 参照 HAL 版 imu_xrobot.h / imu_xrobot.c 移植，差别只有传输层：
 *   HAL 版  : USART1 + DMA 循环 + 空闲中断，在中断里解析
 *   Zephyr 版: USART10（RX=PE2, TX=PE3, 2000000 8N1）DMA 接收 + 环形缓冲，
 *              主循环每 1 ms 调用 imu_update() -> imu_encode() 解析
 *
 * 数据仍然放在全局变量 imu_data 中，任意位置 extern 后直接读取：
 *
 * // 欧拉角（度，驱动内部已从弧度转换）
 * float roll  = imu_data.eulr_.rol;
 * float pitch = imu_data.eulr_.pit;
 * float yaw   = imu_data.eulr_.yaw;
 *
 * // 角速度（rad/s）
 * float gyro_x = imu_data.gyro_.x;
 *
 * // 加速度（m/s^2）
 * float acc_x = imu_data.accl_.x;
 *
 * // 四元数
 * float q0 = imu_data.quat_.q0;
 *
 * ==== 数据帧格式（共 64 字节，小端）====
 *
 * | 偏移 | 字段   | 大小    | 说明                       |
 * |------|--------|---------|----------------------------|
 * | 0    | prefix | 1 字节  | 帧头，固定 0xA5            |
 * | 1    | time   | 5 字节  | 微秒时间戳 (40-bit)        |
 * | 6    | sync   | 5 字节  | 同步时间戳 (40-bit)        |
 * | 11   | quat_  | 16 字节 | 四元数 (4 * float)         |
 * | 27   | gyro_  | 12 字节 | 角速度 (3 * float, rad/s)  |
 * | 39   | accl_  | 12 字节 | 加速度 (3 * float, m/s^2)  |
 * | 51   | eulr_  | 12 字节 | 欧拉角 (3 * float, 弧度)   |
 * | 63   | crc8   | 1 字节  | CRC8 校验 (poly 0x31, 初值 0xFF) |
 ******************************************************************************
 */

#ifndef IMU_XROBOT_H
#define IMU_XROBOT_H

#include <stdint.h>

#define IMU_FRAME_SIZE 64
#define IMU_FRAME_HEAD 0xA5
#define IMU_CRC_INIT 0xFF

/* 弧度转度 (180/π) */
#define RAD_TO_DEG 57.29578f

/* Exported types ------------------------------------------------------------*/

/** @brief 三维向量 */
typedef struct __attribute__((packed))
{
	float x;
	float y;
	float z;
} Vector3;

/** @brief 四元数 */
typedef struct __attribute__((packed))
{
	float q0;
	float q1;
	float q2;
	float q3;
} Quaternion;

/** @brief 欧拉角（字段顺序与线上字节序一致：roll, pitch, yaw） */
typedef struct __attribute__((packed))
{
	float rol; // 横滚角 (度)
	float pit; // 俯仰角 (度)
	float yaw; // 偏航角 (度)
} EulerAngles;

/** @brief 完整 IMU 数据帧结构 */
typedef struct __attribute__((packed))
{
	uint8_t prefix;	  // 帧头，固定 0xA5
	uint8_t time[5];  // 微秒时间戳 (40-bit)
	uint8_t sync[5];  // 同步时间戳 (40-bit)
	Quaternion quat_; // 四元数
	Vector3 gyro_;	  // 陀螺仪角速度 (rad/s)
	Vector3 accl_;	  // 加速度 (m/s^2)
	EulerAngles eulr_; // 欧拉角 (度，解析时已由弧度转换)
	uint8_t crc8;	  // CRC8 校验
} ImuUartData;

_Static_assert(sizeof(ImuUartData) == IMU_FRAME_SIZE,
			   "ImuUartData 必须与线上 64 字节帧一致");

/* Exported variables --------------------------------------------------------*/

/** @brief 最新一帧 IMU 数据（解析成功才会刷新） */
extern ImuUartData imu_data;

/* Exported functions --------------------------------------------------------*/

/**
 * @brief CRC8 计算（查表法）
 *
 * 对应 IMU 帧尾校验：多项式 0x31（反射形式），初始值 0xFF。
 *
 * @param data 待校验数据
 * @param len  字节数（不包括 CRC 本身）
 * @return 计算出的 CRC8 值
 */
uint8_t imu_crc8_calc(const uint8_t *data, uint16_t len);

/**
 * @brief 清空 imu_data 与帧统计计数
 *
 * 在开始接收前调用（imu_uart_start() 内已调用）。
 */
void imu_xrobot_init(void);

/**
 * @brief 从一段原始字节中找帧头、校验 CRC 并更新 imu_data
 *
 * 处理流程：
 *   1. 跳过帧头 0xA5 之前的杂字节；
 *   2. 凑满 IMU_FRAME_SIZE（64 字节）后做 CRC8 校验；
 *   3. 校验通过：整帧拷入 imu_data，并把欧拉角由弧度转为度；
 *      校验失败：只增加 crc 错误计数，imu_data 保持上一帧不变；
 *   4. 无论成败都前进 64 字节，继续解析后面的帧。
 *
 * @param rx_buf 数据缓冲区（不必按帧对齐）
 * @param rx_len 数据长度
 * @return 已消费的字节数；从帧头开始不足一帧时返回帧头位置，由调用者保留
 */
uint16_t imu_encode(const uint8_t *rx_buf, uint16_t rx_len);

#endif /* IMU_XROBOT_H */
```
